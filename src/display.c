
#include "main.h"
const uint8_t font5x8[][5] = {
  {0x00,0x00,0x00,0x00,0x00}, // 32: (space)
  {0x00,0x00,0x5F,0x00,0x00}, // 33: !
  {0x00,0x07,0x00,0x07,0x00}, // 34: "
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  {0x08,0x1C,0x2A,0x08,0x08}, //127: DEL(화살표 등 특수)
};


void ssd1306_i2c_cmd(I2C_TypeDef *i2c, uint8_t cmd) {
    i2c->CR1 &= ~( 1U << 11); 
    i2c->CR1 |= ( 1U << 8 ); 
    while (!(i2c->SR1 & ( 1U << 0 ))) {}
    (void)i2c->SR1;
    i2c->DR = 0x78; // (0x3C << 1)
    while (!(i2c->SR1 & (1U << 1))) {}
    (void)i2c->SR1;
    (void)i2c->SR2;
    i2c->DR = 0x00;
    while (!(i2c->SR1 & (1U << 7))) {}
    i2c->DR = cmd;
    while (!(i2c->SR1 & (1U << 7))) {}
    i2c->CR1 |= ( 1U << 9 );
}

void ssd1306_init(I2C_TypeDef *i2c) {
    ssd1306_i2c_cmd(i2c,0xAE); // Display OFF

    ssd1306_i2c_cmd(i2c,0xA8); // Set Multiplex Ratio
    ssd1306_i2c_cmd(i2c,0x3F);

    ssd1306_i2c_cmd(i2c,0xD3); // Set Display Offset
    ssd1306_i2c_cmd(i2c,0x00);

    ssd1306_i2c_cmd(i2c,0x40); // Set Display Start Line

    ssd1306_i2c_cmd(i2c,0xA1); // Set Segment remap (A0/A1)
    ssd1306_i2c_cmd(i2c,0xC8); // Set COM output scan direction

    ssd1306_i2c_cmd(i2c,0xDA); // Set COM Pins hardware config
    ssd1306_i2c_cmd(i2c,0x12);

    ssd1306_i2c_cmd(i2c,0x81); // Set contrast
    ssd1306_i2c_cmd(i2c,0x7F);

    ssd1306_i2c_cmd(i2c,0xA4); // Entire display ON (resume to RAM)
    ssd1306_i2c_cmd(i2c,0xA6); // Normal display (A7=Inverse)

    ssd1306_i2c_cmd(i2c,0xD5); // Set display clock divide
    ssd1306_i2c_cmd(i2c,0x80);

    ssd1306_i2c_cmd(i2c,0x8D); // Enable charge pump regulator
    ssd1306_i2c_cmd(i2c,0x14);

    ssd1306_i2c_cmd(i2c,0xAF); // Display ON
}

void ssd1306_set_cursor(I2C_TypeDef *i2c, uint8_t col, uint8_t page, uint8_t width) {
    ssd1306_i2c_cmd(i2c,0x21); // Set column address
    ssd1306_i2c_cmd(i2c,col);
    ssd1306_i2c_cmd(i2c,col + width - 1); // 여기를 127말고 width-1로
    ssd1306_i2c_cmd(i2c,0x22); // Set page address
    ssd1306_i2c_cmd(i2c,page);
    ssd1306_i2c_cmd(i2c,page);
}

void ssd1306_i2c_data(I2C_TypeDef *i2c, uint8_t data) {
    i2c->CR1 &= ~( 1U << 11);
    i2c->CR1 |= ( 1U << 8 );
    while (!(i2c->SR1 & ( 1U << 0 ))) {}
    (void)i2c->SR1;
    i2c->DR = 0x78; // (0x3C << 1)
    while (!(i2c->SR1 & (1U << 1))) {}
    (void)i2c->SR1;
    (void)i2c->SR2;
    i2c->DR = 0x40;   // 0x40: 데이터 모드
    while (!(i2c->SR1 & (1U << 7))) {}
    i2c->DR = data;   // 실제 픽셀 데이터
    while (!(i2c->SR1 & (1U << 7))) {}
    i2c->CR1 |= ( 1U << 9 );
}


void ssd1306_draw_char(I2C_TypeDef *i2c, uint8_t col, uint8_t page, char c) {
    // ssd1306_set_cursor(col, page, 6);
    uint8_t buf[6];
    for (int i = 0; i < 5; i++) buf[i] = font5x8[c - 32][i];
    buf[5] = 0x00;
    ssd1306_set_cursor(i2c, col, page, 6);
    ssd1306_i2c_data_multi(i2c, buf, 6);
}
void ssd1306_draw_str(I2C_TypeDef *i2c,uint8_t col, uint8_t page, const char* str) {
    while (*str) {
        ssd1306_draw_char(i2c, col, page, *str++);
        col += 6;
    }
}

void ssd1306_clear(I2C_TypeDef *i2c) {
    uint8_t buf[128] = {0};
    for (uint8_t page = 0; page < 8; page++) {
        ssd1306_set_cursor(i2c,0, page, 128);
        ssd1306_i2c_data_multi(i2c,buf, 128);
    }
}

void ssd1306_i2c_data_multi(I2C_TypeDef *i2c, const uint8_t* data, size_t len) {
    i2c->CR1 &= ~( 1U << 11);
    i2c->CR1 |= ( 1U << 8 );
    while (!(i2c->SR1 & ( 1U << 0 ))) {}
    (void)i2c->SR1;
    i2c->DR = 0x78; // SSD1306 주소
    while (!(i2c->SR1 & (1U << 1))) {}
    (void)i2c->SR1;
    (void)i2c->SR2;

    i2c->DR = 0x40; // 컨트롤 바이트(데이터)
    while (!(i2c->SR1 & (1U << 7))) {}

    for (size_t i = 0; i < len; i++) {
        i2c->DR = data[i];
        while (!(i2c->SR1 & (1U << 7))) {}
    }
    i2c->CR1 |= ( 1U << 9 );
}
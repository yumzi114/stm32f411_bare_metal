#include "main.h"
#define I2C_PWR_EN (1U << 28)
#define I2C1_ENABLE (1U << 21)
#define I2C_CR1_PE_EN (1U << 0)
#define I2C_CR1_SWRST_EN (1U << 15)
#define I2C_CR1_POS_EN ( 1U << 11)
#define I2C_CR1_START_EN ( 1U << 8 )
#define I2C_CR1_STOP_EN ( 1U << 9 )

#define I2C_OAR1_EN (1U << 15)
#define I2C_SR1_SB_EN ( 1U << 0 )
#define I2C1_TXE_FLAG_EN   (1U << 7)
#define I2C1_SR1_ADDR_EN   (1U << 1)
void i2c1_reg_init(){

    I2C1_CR1 &= ~I2C_CR1_PE_EN;
    I2C1_CR1 |= I2C_CR1_SWRST_EN; 
    I2C1_CR1 &= ~I2C_CR1_SWRST_EN; 
    // //주소
    I2C1_OAR1=0x4000;
    // //주변 장치 클럭 48MHz
    I2C1_CR2 = 50;      // APB1 클럭 48MHz
    I2C1_CCR = 250;       // 100kHz (Standard mode)
    I2C1_TRISE = 51;      // TRISE = 49
    I2C1_CR1 |= I2C_CR1_PE_EN; 
}

const uint8_t font5x8[][5] = {
  {0x00,0x00,0x00,0x00,0x00}, // 32: (space)
  {0x00,0x00,0x5F,0x00,0x00}, // 33: !
  {0x00,0x07,0x00,0x07,0x00}, // 34: "
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  {0x08,0x1C,0x2A,0x08,0x08}, //127: DEL(화살표 등 특수)
};


void i2c1_init(){
    // APB1_ENR |= I2C_PWR;
    APB1_ENR |= I2C1_ENABLE;
    
    GPIOB_MODER &= ~(0x3 << (6 * 2));
    GPIOB_MODER |=  (0x2 << (6 * 2));
    GPIOB_MODER &= ~(0x3 << (7 * 2));
    GPIOB_MODER |=  (0x2 << (7 * 2));
    GPIOB_OTYPER |= (1 << 6) | (1 << 7);
    GPIOB_OSPEEDR &= ~(0x3 << (6 * 2));
    GPIOB_OSPEEDR |=  (0x3 << (6 * 2));
    GPIOB_OSPEEDR &= ~(0x3 << (7 * 2));
    GPIOB_OSPEEDR |=  (0x3 << (7 * 2));
    GPIOA_PUPDR &= ~(0x1 << (6 * 2));
    GPIOA_PUPDR &= ~(0x1 << (7 * 2));

    GPIOB_AF_0 &= ~(0xF << (6 * 4));
    GPIOB_AF_0 |= (0x4 << (6 * 4));
    GPIOB_AF_0 &= ~(0xF << (7 * 4));
    GPIOB_AF_0 |= (0x4 << (7 * 4));
    GPIOB_IDR=0x0000;
    i2c1_reg_init();

}


void i2c_write(){
    I2C1_CR1 &= ~I2C_CR1_POS_EN; 
    I2C1_CR1 |= I2C_CR1_START_EN; 
    while(!(I2C1_SR1 & I2C_SR1_SB_EN)){} 
    (void)I2C1_SR1;
    (void)I2C1_SR2; 
    I2C1_DR = 0x78;
    while (!(I2C1_SR1 & I2C1_SR1_ADDR_EN));
    (void)I2C1_SR1;
    (void)I2C1_SR2;
    I2C1_DR = 0x00;  
    while (!(I2C1_SR1 & I2C1_TXE_FLAG_EN));
    I2C1_DR = 0xAF;
    while (!(I2C1_SR1 & I2C1_TXE_FLAG_EN));
    I2C1_CR1 |= I2C_CR1_STOP_EN;

}
void ssd1306_i2c_cmd(uint8_t cmd) {
    I2C1_CR1 &= ~I2C_CR1_POS_EN; 
    I2C1_CR1 |= I2C_CR1_START_EN; 
    while (!(I2C1_SR1 & I2C_SR1_SB_EN)) {}
    (void)I2C1_SR1;
    I2C1_DR = 0x78; // (0x3C << 1)
    while (!(I2C1_SR1 & I2C1_SR1_ADDR_EN)) {}
    (void)I2C1_SR1;
    (void)I2C1_SR2;
    I2C1_DR = 0x00;
    while (!(I2C1_SR1 & I2C1_TXE_FLAG_EN)) {}
    I2C1_DR = cmd;
    while (!(I2C1_SR1 & I2C1_TXE_FLAG_EN)) {}
    I2C1_CR1 |= I2C_CR1_STOP_EN;
}

void ssd1306_init(void) {
    ssd1306_i2c_cmd(0xAE); // Display OFF

    ssd1306_i2c_cmd(0xA8); // Set Multiplex Ratio
    ssd1306_i2c_cmd(0x3F);

    ssd1306_i2c_cmd(0xD3); // Set Display Offset
    ssd1306_i2c_cmd(0x00);

    ssd1306_i2c_cmd(0x40); // Set Display Start Line

    ssd1306_i2c_cmd(0xA1); // Set Segment remap (A0/A1)
    ssd1306_i2c_cmd(0xC8); // Set COM output scan direction

    ssd1306_i2c_cmd(0xDA); // Set COM Pins hardware config
    ssd1306_i2c_cmd(0x12);

    ssd1306_i2c_cmd(0x81); // Set contrast
    ssd1306_i2c_cmd(0x7F);

    ssd1306_i2c_cmd(0xA4); // Entire display ON (resume to RAM)
    ssd1306_i2c_cmd(0xA6); // Normal display (A7=Inverse)

    ssd1306_i2c_cmd(0xD5); // Set display clock divide
    ssd1306_i2c_cmd(0x80);

    ssd1306_i2c_cmd(0x8D); // Enable charge pump regulator
    ssd1306_i2c_cmd(0x14);

    ssd1306_i2c_cmd(0xAF); // Display ON
}

void ssd1306_set_cursor(uint8_t col, uint8_t page, uint8_t width) {
    ssd1306_i2c_cmd(0x21); // Set column address
    ssd1306_i2c_cmd(col);
    ssd1306_i2c_cmd(col + width - 1); // 여기를 127말고 width-1로
    ssd1306_i2c_cmd(0x22); // Set page address
    ssd1306_i2c_cmd(page);
    ssd1306_i2c_cmd(page);
}


void ssd1306_draw_char(uint8_t col, uint8_t page, char c) {
    // ssd1306_set_cursor(col, page, 6);
    uint8_t buf[6];
    for (int i = 0; i < 5; i++) buf[i] = font5x8[c - 32][i];
    buf[5] = 0x00;
    ssd1306_set_cursor(col, page, 6);
    ssd1306_i2c_data_multi(buf, 6);
}
void ssd1306_draw_str(uint8_t col, uint8_t page, const char* str) {
    while (*str) {
        ssd1306_draw_char(col, page, *str++);
        col += 6;
    }
}
void ssd1306_clear(void) {
    uint8_t buf[128] = {0};
    for (uint8_t page = 0; page < 8; page++) {
        ssd1306_set_cursor(0, page, 128);
        ssd1306_i2c_data_multi(buf, 128);
    }
}

void ssd1306_i2c_data(uint8_t data) {
    I2C1_CR1 &= ~I2C_CR1_POS_EN;
    I2C1_CR1 |= I2C_CR1_START_EN;
    while (!(I2C1_SR1 & I2C_SR1_SB_EN)) {}
    (void)I2C1_SR1;
    I2C1_DR = 0x78; // (0x3C << 1)
    while (!(I2C1_SR1 & I2C1_SR1_ADDR_EN)) {}
    (void)I2C1_SR1;
    (void)I2C1_SR2;
    I2C1_DR = 0x40;   // 0x40: 데이터 모드
    while (!(I2C1_SR1 & I2C1_TXE_FLAG_EN)) {}
    I2C1_DR = data;   // 실제 픽셀 데이터
    while (!(I2C1_SR1 & I2C1_TXE_FLAG_EN)) {}
    I2C1_CR1 |= I2C_CR1_STOP_EN;
}

void ssd1306_i2c_data_multi(const uint8_t* data, size_t len) {
    I2C1_CR1 &= ~I2C_CR1_POS_EN;
    I2C1_CR1 |= I2C_CR1_START_EN;
    while (!(I2C1_SR1 & I2C_SR1_SB_EN)) {}
    (void)I2C1_SR1;
    I2C1_DR = 0x78; // SSD1306 주소
    while (!(I2C1_SR1 & I2C1_SR1_ADDR_EN)) {}
    (void)I2C1_SR1;
    (void)I2C1_SR2;

    I2C1_DR = 0x40; // 컨트롤 바이트(데이터)
    while (!(I2C1_SR1 & I2C1_TXE_FLAG_EN)) {}

    for (size_t i = 0; i < len; i++) {
        I2C1_DR = data[i];
        while (!(I2C1_SR1 & I2C1_TXE_FLAG_EN)) {}
    }
    I2C1_CR1 |= I2C_CR1_STOP_EN;
}